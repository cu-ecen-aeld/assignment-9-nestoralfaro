## base_external/package/aesd-assignments/Config.in
```kconfig
config BR2_PACKAGE_AESD_ASSIGNMENTS
	bool "aesd-assignments"
	help
	  Includes the aesdsocket executable, and aesdsocket-start-stop.sh in the kernel image.
	  Used to understand buildroot external trees and package builds.
```

## base_external/package/aesd-char-driver/Config.in
```kconfig
config BR2_PACKAGE_AESD_CHAR_DRIVER
	bool "AESD_CHAR_DRIVER"
	help
	  For AESD Char Driver. Assignment 8
```

## base_external/package/ldd/Config.in
```kconfig
config BR2_PACKAGE_LDD
	bool "ldd"
	help
	  For scull and misc-module kernel modules. LDD for assignment 7 part 2.
```
